## blinking-led/main/Kconfig.projbuild
```kconfig
menu "Blinking Config"

    orsource "$IDF_PATH/examples/common_components/env_caps/$IDF_TARGET/Kconfig.env_caps"

    config BLINK_GPIO
        int "GPIO to blink on"
        range ENV_GPIO_RANGE_MIN ENV_GPIO_OUT_RANGE_MAX
        default 8
        help
            GPIO number (IOxx) to blink on and off the LED.
            Some GPIOs are used for other purposes (flash connections, etc.) and cannot be used to blink.

    config BLINK_DURATION
        int "The duration of the blinking"
        range 10 3600000
        default 1000
        help
            Define the blinking period in milliseconds.

endmenu
```

## buzzers/main/Kconfig.projbuild
```kconfig
menu "Passive Buzzer Config"

    orsource "$IDF_PATH/examples/common_components/env_caps/$IDF_TARGET/Kconfig.env_caps"

    config BUZZ_GPIO
        int "GPIO to buzz on"
        range ENV_GPIO_RANGE_MIN ENV_GPIO_OUT_RANGE_MAX
        default 8

    config BUZZ_DURATION
        int "The duration of the buzzing"
        range 10 3600000
        default 1000

endmenu
```

## dht11/main/Kconfig.projbuild
```kconfig
menu "DHT11 Config"

    orsource "$IDF_PATH/examples/common_components/env_caps/$IDF_TARGET/Kconfig.env_caps"

    config SENSOR_GPIO
        int "The sensor's GPIO"
        range ENV_GPIO_RANGE_MIN ENV_GPIO_OUT_RANGE_MAX
        default 27

    config POLL_RATE_MS
        int "The rate at which the sensor will poll in ms"
        range 1000 5000
        default 1000

endmenu
```

## digital-inputs/main/Kconfig.projbuild
```kconfig
menu "Input Config"

    orsource "$IDF_PATH/examples/common_components/env_caps/$IDF_TARGET/Kconfig.env_caps"

    config LED_GPIO
        int "The LED GPIO"
        range ENV_GPIO_RANGE_MIN ENV_GPIO_OUT_RANGE_MAX
        default 27

    config INPUT_GPIO
        int "The GPIO to detect input"
        range ENV_GPIO_RANGE_MIN ENV_GPIO_OUT_RANGE_MAX
        default 4

endmenu
```

## numpad/main/Kconfig.projbuild
```kconfig
menu "Keypad config"

    orsource "$IDF_PATH/examples/common_components/env_caps/$IDF_TARGET/Kconfig.env_caps"

    config GPIO_ROW_0
        int "GPIO for row 0"
        range ENV_GPIO_RANGE_MIN ENV_GPIO_OUT_RANGE_MAX
        default 27

    config GPIO_ROW_1
        int "GPIO for row 1"
        range ENV_GPIO_RANGE_MIN ENV_GPIO_OUT_RANGE_MAX
        default 27

    config GPIO_ROW_2
        int "GPIO for row 2"
        range ENV_GPIO_RANGE_MIN ENV_GPIO_OUT_RANGE_MAX
        default 27

    config GPIO_ROW_3
        int "GPIO for row 3"
        range ENV_GPIO_RANGE_MIN ENV_GPIO_OUT_RANGE_MAX
        default 27

    config GPIO_COLUMN_0
        int "GPIO for column 0"
        range ENV_GPIO_RANGE_MIN ENV_GPIO_OUT_RANGE_MAX
        default 27

    config GPIO_COLUMN_1
        int "GPIO for column 1"
        range ENV_GPIO_RANGE_MIN ENV_GPIO_OUT_RANGE_MAX
        default 27

    config GPIO_COLUMN_2
        int "GPIO for column 2"
        range ENV_GPIO_RANGE_MIN ENV_GPIO_OUT_RANGE_MAX
        default 27

    config GPIO_COLUMN_3
        int "GPIO for column 3"
        range ENV_GPIO_RANGE_MIN ENV_GPIO_OUT_RANGE_MAX
        default 27

endmenu
```

## rgb-led/main/Kconfig.projbuild
```kconfig
menu "RGB Config"
    orsource "$IDF_PATH/examples/common_components/env_caps/$IDF_TARGET/Kconfig.env_caps"

    config RED_GPIO
        int "GPIO to output red"
        range ENV_GPIO_RANGE_MIN ENV_GPIO_OUT_RANGE_MAX
        default 8

    config GREEN_GPIO
        int "GPIO to output green"
        range ENV_GPIO_RANGE_MIN ENV_GPIO_OUT_RANGE_MAX
        default 4

    config BLUE_GPIO
        int "GPIO to output blue"
        range ENV_GPIO_RANGE_MIN ENV_GPIO_OUT_RANGE_MAX
        default 5

    config RED_LEDC_CHANNEL
        int "LEDC_CHANNEL to output red"
        default 0

    config GREEN_LEDC_CHANNEL
        int "LEDC_CHANNEL to output green"
        default 1

    config BLUE_LEDC_CHANNEL
        int "LEDC_CHANNEL to output blue"
        default 2

    config RED_LEDC_TIMER
        int "LEDC_TIMER to output red"
        default 0

    config GREEN_LEDC_TIMER
        int "LEDC_TIMER to output green"
        default 1

    config BLUE_LEDC_TIMER
        int "LEDC_TIMER to output blue"
        default 2

    config LIGHT_SATURATION
        int "The saturation of the light"
        range 0 255
        default 204

    config LIGHT_VALUE
        int "The value of the light"
        range 0 255
        default 255

endmenu
```

## servo/main/Kconfig.projbuild
```kconfig
menu "Servo Config"
    orsource "$IDF_PATH/examples/common_components/env_caps/$IDF_TARGET/Kconfig.env_caps"

    config SERVO_GPIO
        int "GPIO to output the servo angle"
        range ENV_GPIO_RANGE_MIN ENV_GPIO_OUT_RANGE_MAX
        default 4

endmenu
```

## ultrasonic-sensor/main/Kconfig.projbuild
```kconfig
menu "Ultrasonic Sensor Config"
    orsource "$IDF_PATH/examples/common_components/env_caps/$IDF_TARGET/Kconfig.env_caps"

    config INTR_GPIO
        int "The interrupt GPIO"
        range ENV_GPIO_RANGE_MIN ENV_GPIO_OUT_RANGE_MAX
        default 27

    config OUT_GPIO
        int "The output GPIO"
        range ENV_GPIO_RANGE_MIN ENV_GPIO_OUT_RANGE_MAX
        default 22

    config TIMEOUT_MS
        int "The timeout for the notification wait"
	default 23

    config TASK_DELAY_MS
        int "The delay on every loop of the task"
	default 100

endmenu
```
